## base_external/Config.in
```kconfig
menu "AESD Assignments"

source "$BR2_EXTERNAL_PROJECT_BASE_PATH/package/aesd-assignments/Config.in"

endmenu
```

## base_external/package/ldd/Config.in
```kconfig
config BR2_PACKAGE_LDD
        bool "ldd"
        help
          Linux Device Drivers kernel modules
          (misc-modules and scull)
```
